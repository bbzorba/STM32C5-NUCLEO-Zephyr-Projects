## CMakeLists.txt
```
cmake_minimum_required(VERSION 3.20.0)
find_package(Zephyr REQUIRED HINTS $ENV{ZEPHYR_BASE})
project(Intr_Btn_LED_Blink)

target_sources(app PRIVATE src/main.c)
```

## prj.conf
```kconfig
CONFIG_STDOUT_CONSOLE=y
CONFIG_GPIO=y
CONFIG_MINIMAL_LIBC=y
CONFIG_DEBUG_OPTIMIZATIONS=y

# Keep the CPU sleeping while idle.
#
# Note: On some STM32 setups, enabling CONFIG_PM/CONFIG_PM_DEVICE can select
# deeper low-power states where GPIO wake/LED control becomes unreliable
# without additional board-specific wake configuration.
# Tickless idle still allows WFI sleep without periodic SysTick wakeups.
# CONFIG_PM is not set
# CONFIG_PM_DEVICE is not set
CONFIG_TICKLESS_KERNEL=y
```

## boards/nucleo_c562re.overlay
```dts
/*
 * Workspace-level overlay for NUCLEO-C562RE (STM32C562RE)
 *
 * Shared by all applications in this workspace.
 *
 * Board: external/zephyr/boards/st/nucleo_c562re/nucleo_c562re.dts
 *   led0  -> green_led_1 -> PA5  (GPIO_ACTIVE_HIGH)
 *   sw0   -> user_button -> PC13 (GPIO_ACTIVE_HIGH)
 *
 * Problem: The board DTS enables SPI1 (status = "okay") with spi1_sck_pa5,
 *          which conflicts with LD1 (PA5). Disable SPI1 to free PA5 as a
 *          GPIO output for the LED.
 */

/* Disable SPI1 — its SCK (PA5) conflicts with LD1 (led0) */
&spi1 {
    status = "disabled";
};

/* Explicitly enable GPIOA (LED LD1 on PA5) */
&gpioa {
    status = "okay";
};

/* Explicitly enable GPIOC (user button on PC13) */
&gpioc {
    status = "okay";
};
```

## src/main.c
```c
/*
 * Copyright (c) 2016 Intel Corporation
 *
 * SPDX-License-Identifier: Apache-2.0
 */

#include <stdio.h>
#include <zephyr/kernel.h>
#include <zephyr/drivers/gpio.h>
#include <zephyr/sys/printk.h>

/* The devicetree node identifier for the "led0" alias. */
#define LED0_NODE DT_ALIAS(led0)

/* The devicetree node identifier for the "sw0" alias (user button). */
#define SW0_NODE DT_ALIAS(sw0)

/* nucleo_c562re has a single user LED (green, PA5) aliased as led0. */
static const struct gpio_dt_spec leds[] = {
	GPIO_DT_SPEC_GET(LED0_NODE, gpios),
};

static const struct gpio_dt_spec button = GPIO_DT_SPEC_GET(SW0_NODE, gpios);

static struct gpio_callback button_cb_data;
static K_SEM_DEFINE(button_sem, 0, 1);

#define BUTTON_IRQ_FLAGS_PRESS (GPIO_INT_EDGE_TO_ACTIVE)
#define BUTTON_IRQ_FLAGS_RELEASE (GPIO_INT_EDGE_TO_INACTIVE)

#define BUTTON_DEBOUNCE_MS 30

/*
 * Locked configuration:
 * - Internal pull-down to avoid floating
 * - Active-high (pressed reads 1)
 *
 * Note: Zephyr's stm32f4_disco board DTS also defines USER button (PA0) as
 * GPIO_ACTIVE_HIGH.
 */
#define BUTTON_FLAGS (GPIO_INPUT | GPIO_PULL_DOWN)

static void set_all_leds(int value)
{
	for (size_t i = 0; i < ARRAY_SIZE(leds); i++) {
		(void)gpio_pin_set_dt(&leds[i], value);
	}
}

static void button_ISR(const struct device *dev, struct gpio_callback *cb, uint32_t pins)
{
	ARG_UNUSED(dev);
	ARG_UNUSED(cb);
	ARG_UNUSED(pins);
	k_sem_give(&button_sem);
}

int main(void)
{
	int ret;

	for (size_t i = 0; i < ARRAY_SIZE(leds); i++) {
		if (!gpio_is_ready_dt(&leds[i])) {
			printf("LED%u GPIO device not ready\n", (unsigned)i);
			return 0;
		}

		ret = gpio_pin_configure_dt(&leds[i], GPIO_OUTPUT_INACTIVE);
		if (ret < 0) {
			printf("Failed to configure LED%u (err %d)\n", (unsigned)i, ret);
			return 0;
		}
	}

	if (!gpio_is_ready_dt(&button)) {
		printf("Button GPIO device not ready\n");
		return 0;
	}

	ret = gpio_pin_configure_dt(&button, BUTTON_FLAGS);
	if (ret < 0) {
		printf("Failed to configure button (err %d)\n", ret);
		return 0;
	}

	gpio_init_callback(&button_cb_data, button_ISR, BIT(button.pin));
	ret = gpio_add_callback(button.port, &button_cb_data);
	if (ret < 0) {
		printf("Failed to add button callback (err %d)\n", ret);
		return 0;
	}

	printf("Button on %s pin %u configured: PULL_DOWN + ACTIVE_HIGH (dt_flags=0x%x)\n",
	       button.port->name,
	       (unsigned)button.pin,
	       (unsigned)button.dt_flags);

	/* Start by waiting for a press edge. */
	ret = gpio_pin_interrupt_configure_dt(&button, BUTTON_IRQ_FLAGS_PRESS);
	if (ret < 0) {
		printf("Failed to configure button press interrupt (err %d)\n", ret);
		return 0;
	}

	printk("Sleep demo started. Waiting for button press...\n");

	while (1) {
		static bool leds_on;
		static bool waiting_for_release;
		int val;
		int want;

		/* Block forever; when power management is enabled this allows the idle
		 * thread to put the MCU into a low-power state until an interrupt occurs.
		 */
		if (!waiting_for_release) {
			printk("SLEEP: waiting for press\n");
		} else {
			printk("SLEEP: waiting for release\n");
		}
		(void)k_sem_take(&button_sem, K_FOREVER);
		printk("WAKE: interrupt\n");

		/* Simple debounce: wait a bit then sample pin.
		 * This avoids mechanical bounce causing double toggles or inconsistent
		 * observed behavior.
		 */
		k_msleep(BUTTON_DEBOUNCE_MS);
		val = gpio_pin_get_dt(&button);
		if (val < 0) {
			printk("ERR: gpio_pin_get_dt failed (%d)\n", val);
			continue;
		}

		want = waiting_for_release ? 0 : 1;
		if (val != want) {
			/* Spurious edge or bounce; keep waiting in the same state. */
			printk("IGN: unexpected pin=%d (want %d)\n", val, want);
			continue;
		}

		if (!waiting_for_release) {
			/* Stable press confirmed: toggle LEDs and then wait for release edge. */
			leds_on = !leds_on;
			set_all_leds(leds_on ? 1 : 0);
			printk("BTN: pressed -> LEDs %s\n", leds_on ? "ON" : "OFF");

			waiting_for_release = true;
			ret = gpio_pin_interrupt_configure_dt(&button, BUTTON_IRQ_FLAGS_RELEASE);
			if (ret < 0) {
				printk("ERR: configure release interrupt failed (%d)\n", ret);
				return 0;
			}
		} else {
			/* Stable release confirmed: go back to waiting for press edge. */
			printk("BTN: released\n");
			waiting_for_release = false;
			ret = gpio_pin_interrupt_configure_dt(&button, BUTTON_IRQ_FLAGS_PRESS);
			if (ret < 0) {
				printk("ERR: configure press interrupt failed (%d)\n", ret);
				return 0;
			}
		}
	}
}
```
